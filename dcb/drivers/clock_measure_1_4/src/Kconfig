## dcb/drivers/clock_measure_1_4/src/Kconfig
```kconfig
#
# PSI Clock Measurement IP
#

config CLOCK_MEASURE_1_4
  tristate "PSI clock measurement IP"
  default m
  help
    This driver supports the PSI clock measure IP v1.4 available at
    https://github.com/paulscherrerinstitute/vivadoIP_clock_measure

    The IP can be used to measure multiple clock frequencies in the
    programmable logic (PL) of a Xilinx ZYNQ SoC. With the help of
    this driver, the measurement results are made accessible from
    user space (e.g. under /dev/clk_meas0).
```

## dcb/drivers/dma_packet_scheduler_v1_0/src/Kconfig
```kconfig
#
# PSI WaveDAQ DMA packet scheduler
#

config DMA_PACKET_SCHEDULER_V1_0
  tristate "WDAQ DMA packet scheduler IP"
  default m
  help
    This driver supports the WaveDAQ DMA packet scheduler IP v1.0 available in
    https://github.com/paulscherrerinstitute/vivadoIP_clock_measure

    The IP stores packets received from several external sources into
    memory using DMA.
    The driver receives interrupts from the IP core and puts the buffers
    containing the data written via DMA into a queue so they can be processed
    in the order they arrived. The buffer representing the head of the queue
    can be accessed through /dev/dma_pkt_sched0 file.
```
